## tm1638/Kconfig.projbuild
```kconfig
menu "TM1638 Configuration"

	config GPIO_RANGE_MAX
		int
		default 33 if IDF_TARGET_ESP32
		default 46 if IDF_TARGET_ESP32S2
		default 19 if IDF_TARGET_ESP32C3
		default 48 if IDF_TARGET_ESP32S3

	config TM1638_DIO_GPIO
		prompt "DIO pin"
		gpio_num_t "DIO (MOSI) GPIO number"
		range 0 GPIO_RANGE_MAX
		default 23 if IDF_TARGET_ESP32
		default 35 if IDF_TARGET_ESP32S2
		default 35 if IDF_TARGET_ESP32S3
		default  0 if IDF_TARGET_ESP32C3
		help
			GPIO number (IOxx) for DIO pin on the T1638 (MOSI/MISO on the ESP)
			Some GPIOs are used for other purposes (flash connections, etc.) and cannot be used.
			On the ESP32, GPIOs 35-39 are input-only so cannot be used as outputs.
			On the ESP32-S2, GPIO 46 is input-only so cannot be used as outputs.

	config TM1638_CLK_GPIO
		prompt "CLK pin"
		gpio_num_t "CLK GPIO number"
		range 0 GPIO_RANGE_MAX
		default 18 if IDF_TARGET_ESP32
		default 36 if IDF_TARGET_ESP32S2
		default 36 if IDF_TARGET_ESP32S3
		default  1 if IDF_TARGET_ESP32C3
		help
			GPIO number (IOxx) to SPI CLK.
			Some GPIOs are used for other purposes (flash connections, etc.) and cannot be used to DC.
			On the ESP32, GPIOs 35-39 are input-only so cannot be used as outputs.
			On the ESP32-S2, GPIO 46 is input-only so cannot be used as outputs.

	config TM1638_STB_GPIO
		prompt "STB pin"
		gpio_num_t "STB GPIO number"
		range 0 GPIO_RANGE_MAX
		default 13
		help
			GPIO number (IOxx) for STB pin.
			Some GPIOs are used for other purposes (flash connections, etc.) and cannot be used to CS.
			GPIOs 35-39 are input-only so cannot be used as outputs.

	choice INTERFACE
		prompt "Interface"
		default SPI_INTERFACE
		help
			Select Interface.
		config GPIO_INTERFACE
			bool "GPIO Interface"
			help
				Use GPIO to bitbang communication.
		config SPI_INTERFACE
			bool "SPI Interface"
			help
				SPI Interface.
	endchoice

	config SPI_FREQUENCY
		depends on SPI_INTERFACE
		int "SPI INTERFACE"
		range 10000 1000000
		default 500000 
		help
			SPI Frequency. TM1638 support min pulse width of 400ns so little bit more than 1MHz so 1MHz is safe upper limit.
			To fight external noise on longer line use lower speeds.



endmenu
```
